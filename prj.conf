## CMakeLists.txt
```
# Zephyr Example Application

cmake_minimum_required(VERSION 3.20.0)

# The default board for this example is the qemu_cortex_m3, but can be
# overridden by passing --board=<board> to west or -DBOARD=<board> to cmake
set(BOARD mimxrt1024_evk)

find_package(Zephyr REQUIRED HINTS $ENV{ZEPHYR_BASE})

add_subdirectory(src)

zephyr_include_directories(config)
project(memfault-zephyr-http-example LANGUAGES C VERSION 1.0.0)

# Generate a git hash that's used as part of the software_version, eg
# 1.0.0+12345678. Permit overriding at command line for CI builds.
if (NOT DEFINED ZEPHYR_MEMFAULT_EXAMPLE_GIT_SHA1)
  EXECUTE_PROCESS(
    WORKING_DIRECTORY ${CMAKE_CURRENT_SOURCE_DIR}
    COMMAND git rev-parse --short HEAD
    RESULT_VARIABLE commit_sha1
    OUTPUT_VARIABLE ZEPHYR_MEMFAULT_EXAMPLE_GIT_SHA1
    OUTPUT_STRIP_TRAILING_WHITESPACE
    COMMAND_ERROR_IS_FATAL ANY
  )
endif()

zephyr_compile_definitions(
  ZEPHYR_MEMFAULT_EXAMPLE_GIT_SHA1=\"${ZEPHYR_MEMFAULT_EXAMPLE_GIT_SHA1}\"
)
```

## Kconfig
```
# Application Kconfig file
#
# This is loaded when building this directory with west.
menu "Memfault Example Application Configuration"

config ZEPHYR_MEMFAULT_EXAMPLE_SOFTWARE_VERSION
    string "Software Version"
    default "1.0.0"
    help
      The software version to report to Memfault.

config MEMFAULT_PROJECT_KEY
    string "Memfault Project Key"
    depends on MEMFAULT_HTTP_ENABLE
    help
      The project key for the Memfault project to report to.

endmenu

source "Kconfig.zephyr"
```

## sample.yaml
```
common:
  tags: memfault
  platform_allow: >
    mimxrt1024_evk frdm_mcxn947/mcxn947/cpu0
sample:
  description: Memfault HTTP Client Example
  name: memfault-zephyr-http-example
tests:
  sample.build:
    build_only: true
    extra_configs:
      - CONFIG_MEMFAULT_PROJECT_KEY="dummy"
```

## west.yml
```
# West manifest for Memfault Example Application

manifest:
  projects:
    - name: zephyr
      url: https://github.com/zephyrproject-rtos/zephyr
      revision: v3.7.0

      import:
        # Limit the Zephyr modules to the required set
        name-allowlist:
          - cmsis
          - hal_nxp
          - mbedtls
          - mcuboot
          - picolibc
          - segger # required, the NXP boards y-select HAS_SEGGER_RTT

    - name: memfault-firmware-sdk
      path: modules/lib/memfault-firmware-sdk
      url: https://github.com/memfault/memfault-firmware-sdk
      revision: "1.11.2"
```

## prj.conf
```kconfig
# This file contains selected Kconfig options for the application.

# Memfault configuration
CONFIG_MEMFAULT=y
CONFIG_MEMFAULT_LOGGING_ENABLE=y
CONFIG_MEMFAULT_LOG_LEVEL_DBG=y
CONFIG_MEMFAULT_COMPACT_LOG=y
CONFIG_MEMFAULT_HEAP_STATS=y

# Enable UART console and shell for testing memfault
CONFIG_CONSOLE=y
CONFIG_UART_CONSOLE=y
CONFIG_SHELL=y

# Log settings. Using immediate mode to not drop bursty logs
CONFIG_LOG=y
CONFIG_LOG_MODE_IMMEDIATE=y
CONFIG_LOG_BACKEND_UART=y
CONFIG_SHELL_LOG_BACKEND=n
CONFIG_LOG_PRINTK=n

CONFIG_HEAP_MEM_POOL_SIZE=4096
CONFIG_MAIN_STACK_SIZE=4096
CONFIG_SHELL_STACK_SIZE=4096
CONFIG_SYSTEM_WORKQUEUE_STACK_SIZE=2048

CONFIG_ASSERT=y
CONFIG_COMPILER_WARNINGS_AS_ERRORS=y

# hwinfo is used for device serial (based on chip UID) and reboot reason
CONFIG_HWINFO=y

# Required for using pyOCD to flash the application
CONFIG_BUILD_OUTPUT_HEX=y

# Memfault internet settings
CONFIG_MEMFAULT_HTTP_ENABLE=y
CONFIG_MEMFAULT_HTTP_PERIODIC_UPLOAD=y
CONFIG_POSIX_API=y

# Network settings
CONFIG_NETWORKING=y
CONFIG_NET_L2_ETHERNET=y
CONFIG_NET_IPV4=y
CONFIG_NET_DHCPV4=y
CONFIG_NET_SHELL=y
CONFIG_NET_SOCKETS=y
CONFIG_NET_SOCKETS_SOCKOPT_TLS=y
CONFIG_NET_LOG=y
CONFIG_NET_TCP=y ### THIS IS IMPORTANT

CONFIG_NET_STATISTICS=y
CONFIG_NET_STATISTICS_USER_API=y

CONFIG_MBEDTLS=y
CONFIG_MBEDTLS_SERVER_NAME_INDICATION=y
CONFIG_TLS_CREDENTIALS=y
CONFIG_DNS_RESOLVER=y
CONFIG_DNS_SERVER_IP_ADDRESSES=y
CONFIG_DNS_SERVER1="1.1.1.1"
CONFIG_MBEDTLS_SHA1=y

CONFIG_MBEDTLS_BUILTIN=y
CONFIG_MBEDTLS_ENABLE_HEAP=y
CONFIG_MBEDTLS_HEAP_SIZE=34000
CONFIG_MBEDTLS_SSL_MAX_CONTENT_LEN=4096

# 1536 seems to be the minimum for the MCXN947 when we send memfault data
# CONFIG_NET_BUF_DATA_SIZE=512
CONFIG_NET_BUF_DATA_SIZE=1536

# debug
# CONFIG_MBEDTLS_DEBUG=y
# CONFIG_MBEDTLS_LOG_LEVEL_DBG=y
# CONFIG_NET_SOCKETS_LOG_LEVEL_DBG=y
# CONFIG_NET_LOG=y
# CONFIG_NET_BUF_LOG=y
# CONFIG_NET_BUF_LOG_LEVEL_DBG=y
# CONFIG_NET_BUF_SIMPLE_LOG=y
# CONFIG_NET_L2_ETHERNET_LOG_LEVEL_DBG=y
```

## overlay-http.conf
```kconfig
# Memfault internet settings
CONFIG_MEMFAULT_HTTP_ENABLE=y
CONFIG_MEMFAULT_HTTP_PERIODIC_UPLOAD=y
CONFIG_POSIX_API=y

# Network settings
CONFIG_NETWORKING=y
CONFIG_NET_L2_ETHERNET=y
CONFIG_NET_IPV4=y
CONFIG_NET_DHCPV4=y
CONFIG_NET_SHELL=y
CONFIG_NET_SOCKETS=y
CONFIG_NET_SOCKETS_SOCKOPT_TLS=y
CONFIG_NET_LOG=y
CONFIG_NET_TCP=y ### THIS IS IMPORTANT

CONFIG_NET_STATISTICS=y
CONFIG_NET_STATISTICS_USER_API=y

CONFIG_MBEDTLS=y
CONFIG_MBEDTLS_SERVER_NAME_INDICATION=y
CONFIG_TLS_CREDENTIALS=y
CONFIG_DNS_SERVER_IP_ADDRESSES=y
CONFIG_DNS_SERVER1="1.1.1.1"
# TODO, the PEM certs fail to parse, I suspect due to OOM
CONFIG_MEMFAULT_TLS_CERTS_USE_DER=y

CONFIG_MBEDTLS_BUILTIN=y
CONFIG_MBEDTLS_ENABLE_HEAP=y
CONFIG_MBEDTLS_HEAP_SIZE=34000
CONFIG_MBEDTLS_SSL_MAX_CONTENT_LEN=4096

# 1536 seems to be the minimum for the MCXN947 when we send memfault data
# CONFIG_NET_BUF_DATA_SIZE=512
CONFIG_NET_BUF_DATA_SIZE=1536

# debug
# CONFIG_MBEDTLS_DEBUG=y
# CONFIG_MBEDTLS_LOG_LEVEL_DBG=y
# CONFIG_NET_SOCKETS_LOG_LEVEL_DBG=y
# CONFIG_NET_LOG=y
# CONFIG_NET_BUF_LOG=y
# CONFIG_NET_BUF_LOG_LEVEL_DBG=y
# CONFIG_NET_BUF_SIMPLE_LOG=y
# CONFIG_NET_L2_ETHERNET_LOG_LEVEL_DBG=y
```

## boards/mimxrt1024_evk.conf
```kconfig
# Disable ram-backed coredump, using custom flash-backed instead
CONFIG_MEMFAULT_RAM_BACKED_COREDUMP=n

# Enable flash map and image manager
CONFIG_FLASH=y
CONFIG_FLASH_MAP=y
CONFIG_STREAM_FLASH=y
CONFIG_IMG_MANAGER=y

# Larger coredumps are now supported
CONFIG_MEMFAULT_COREDUMP_STACK_SIZE_TO_COLLECT=1024

# For cpu_temp metric
CONFIG_SENSOR=y
CONFIG_ADC=y
```

## boards/mimxrt1024_evk.overlay
```dts
// Enable temperature sensor
/ {
	aliases {
		die-temp0 = &tempmon;
	};
};

&tempmon {
	status = "okay";
};
```

## src/main.c
```c
//! @file
//!
//! Copyright (c) Memfault, Inc.
//! See License.txt for details
//!
//! Example app main

// clang-format off
#include "memfault/ports/zephyr/include_compatibility.h"

#include MEMFAULT_ZEPHYR_INCLUDE(device.h)
#include MEMFAULT_ZEPHYR_INCLUDE(devicetree.h)
#include MEMFAULT_ZEPHYR_INCLUDE(drivers/gpio.h)
#include MEMFAULT_ZEPHYR_INCLUDE(kernel.h)
#include MEMFAULT_ZEPHYR_INCLUDE(logging/log.h)
#include MEMFAULT_ZEPHYR_INCLUDE(shell/shell.h)
#include MEMFAULT_ZEPHYR_INCLUDE(drivers/hwinfo.h)
#include <zephyr/net/net_if.h>
#include <zephyr/net/dhcpv4.h>

#include "cdr.h"
#include "memfault/components.h"
#include "memfault/ports/zephyr/core.h"
#include "memfault/ports/zephyr/http.h"
// clang-format on

LOG_MODULE_REGISTER(main, LOG_LEVEL_INF);

// Blink code taken from the zephyr/samples/basic/blinky example.
static void blink_forever(void) {
/* 1000 msec = 1 sec */
#define SLEEP_TIME_MS 1000

/* The devicetree node identifier for the "led0" alias. */
#define LED0_NODE DT_ALIAS(led0)

  static const struct gpio_dt_spec led = GPIO_DT_SPEC_GET(LED0_NODE, gpios);

  int ret = gpio_pin_configure_dt(&led, GPIO_OUTPUT_ACTIVE);
  if (ret < 0) {
    return;
  }

  while (1) {
    gpio_pin_toggle_dt(&led);
    k_msleep(SLEEP_TIME_MS);
  }
}

static const char *prv_get_device_id(void) {
  uint8_t dev_id[16] = { 0 };
  static char dev_id_str[sizeof(dev_id) * 2 + 1];
  static const char *dev_str = "UNKNOWN";

  // Obtain the device id
  ssize_t length = hwinfo_get_device_id(dev_id, sizeof(dev_id));

  // If this fails for some reason, use a fixed ID instead
  if (length <= 0) {
    dev_str = CONFIG_SOC_SERIES "-test";
    length = strlen(dev_str);
  } else {
    // Render the obtained serial number in hexadecimal representation
    for (size_t i = 0; i < length; i++) {
      (void)snprintf(&dev_id_str[i * 2], sizeof(dev_id_str), "%02x", dev_id[i]);
    }
    dev_str = dev_id_str;
  }

  return dev_str;
}

void memfault_platform_get_device_info(sMemfaultDeviceInfo *info) {
  *info = (sMemfaultDeviceInfo){
    .device_serial = prv_get_device_id(),
    .software_type = "zephyr-app",
    .software_version =
      CONFIG_ZEPHYR_MEMFAULT_EXAMPLE_SOFTWARE_VERSION "+" ZEPHYR_MEMFAULT_EXAMPLE_GIT_SHA1,
    .hardware_version = CONFIG_BOARD,
  };
}

static void initialize_net(void) {
#if defined(CONFIG_NETWORKING)
  #if defined(CONFIG_MEMFAULT_METRICS_CONNECTIVITY_CONNECTED_TIME)
  memfault_metrics_connectivity_connected_state_change(kMemfaultMetricsConnectivityState_Started);
  #endif

  memfault_zephyr_port_install_root_certs();

  struct net_if *iface = net_if_get_default();

  if (!iface) {
    LOG_ERR("No network interface found");
    return;
  }

  if (net_if_flag_is_set(iface, NET_IF_DORMANT)) {
    LOG_INF("Waiting for interface to be up");
    while (!net_if_is_up(iface)) {
      k_sleep(K_MSEC(100));
    }
  }

  LOG_INF("Starting DHCP to obtain IP address");
  net_dhcpv4_start(iface);
  (void)net_mgmt_event_wait_on_iface(iface, NET_EVENT_IPV4_DHCP_BOUND, NULL, NULL, NULL, K_FOREVER);

  LOG_INF("Network is up");

  #if defined(CONFIG_MEMFAULT_METRICS_CONNECTIVITY_CONNECTED_TIME)
  memfault_metrics_connectivity_connected_state_change(kMemfaultMetricsConnectivityState_Connected);
  #endif

  // print out the IP address
  char addr_str[NET_IPV4_ADDR_LEN];
  LOG_INF("IP Address: %s", net_addr_ntop(AF_INET,
  // the interface ip address structure was changed in zephyr commit
  // 1b0f9e865e35a6b3e1ca8aad7a67f7cfbfc2e666
  #if MEMFAULT_ZEPHYR_VERSION_GT(3, 6)
                                          &iface->config.ip.ipv4->unicast[0].ipv4.address.in_addr,
  #else
                                          &iface->config.ip.ipv4->unicast[0].address.in_addr,
  #endif
                                          addr_str, sizeof(addr_str)));

#endif  // CONFIG_NETWORKING
}

// put the blink_forever in its own thread.
K_THREAD_DEFINE(blink_forever_thread, 1024, blink_forever, NULL, NULL, NULL, K_PRIO_PREEMPT(8), 0,
                0);

int main(void) {
  printk(MEMFAULT_BANNER_COLORIZED);
  LOG_INF("👋 Memfault Demo App! Board %s\n", CONFIG_BOARD);
  memfault_device_info_dump();

  memfault_cdr_register_source(&g_custom_data_recording_source);

#if !defined(CONFIG_MEMFAULT_RECORD_REBOOT_ON_SYSTEM_INIT)
  memfault_zephyr_collect_reset_info();
#endif

  initialize_net();

  return 0;
}
```

## src/memfault_platform_coredump_storage.c
```c
//! @file
//!
//! Memfault coredump storage implementation for the RT1024 (Zephyr flash_map
//! API)

#include <zephyr/storage/flash_map.h>

#include "memfault/components.h"
#include "memfault/config.h"

// This is inspired by the Zephyr coredump_backend_flash_partition.c
// implementation
#define FLASH_PARTITION storage_partition
#define FLASH_PARTITION_ID FIXED_PARTITION_ID(FLASH_PARTITION)

#if !FIXED_PARTITION_EXISTS(FLASH_PARTITION)
  #error "Need a fixed partition named 'storage_partition'!"
#endif

#define FLASH_CONTROLLER DT_PARENT(DT_PARENT(DT_NODELABEL(FLASH_PARTITION)))

#define FLASH_WRITE_SIZE DT_PROP(FLASH_CONTROLLER, write_block_size)
#define FLASH_ERASE_SIZE DT_PROP(FLASH_CONTROLLER, erase_block_size)
// reg index 1 is size
#define FLASH_STORAGE_SIZE DT_PROP_BY_IDX(DT_NODELABEL(FLASH_PARTITION), reg, 1)

// Compute the memory-mapped address of the coredump storage partition, used for
// reading data.
// reg index 0 is offset
#define FLASH_STORAGE_PARTITION_OFFSET DT_PROP_BY_IDX(DT_NODELABEL(FLASH_PARTITION), reg, 0)
// reg index 2 is offset
#define FLASH_STORAGE_MEMMAPPED_ADDRESS \
  (DT_PROP_BY_IDX(DT_PARENT(FLASH_CONTROLLER), reg, 2) + FLASH_STORAGE_PARTITION_OFFSET)

#define MEMFAULT_COREDUMP_STORAGE_WRITE_SIZE FLASH_WRITE_SIZE
#include <string.h>

#include "memfault/ports/buffered_coredump_storage.h"

// Error writing to flash - should never happen & likely detects a configuration
// error Call the reboot handler which will halt the device if a debugger is
// attached and then reboot
MEMFAULT_NO_OPT static void prv_coredump_writer_assert_and_reboot(int error_code) {
  (void)error_code;
  memfault_platform_halt_if_debugging();
  memfault_platform_reboot();
}

static bool prv_op_within_flash_bounds(uint32_t offset, size_t data_len) {
  sMfltCoredumpStorageInfo info = { 0 };
  memfault_platform_coredump_storage_get_info(&info);
  return (offset + data_len) <= info.size;
}

void memfault_platform_coredump_storage_clear(void) {
  const struct flash_area *flash_area;
  int ret = flash_area_open(FLASH_PARTITION_ID, &flash_area);
  if (ret == 0) {
    ret = flash_area_erase(flash_area, 0, FLASH_ERASE_SIZE);
  }
  flash_area_close(flash_area);

  if (ret) {
    MEMFAULT_LOG_ERROR("Failed to clear coredump storage, rv=%d", ret);
  }
}

const sMfltCoredumpStorageInfo s_coredump_storage_info = {
  .size = FLASH_STORAGE_SIZE,
  .sector_size = FLASH_ERASE_SIZE,
};
void memfault_platform_coredump_storage_get_info(sMfltCoredumpStorageInfo *info) {
  *info = s_coredump_storage_info;
}

bool memfault_platform_coredump_storage_buffered_write(sCoredumpWorkingBuffer *blk) {
  const struct flash_area *flash_area;
  int ret = flash_area_open(FLASH_PARTITION_ID, &flash_area);
  if (ret == 0) {
    ret = flash_area_write(flash_area, blk->write_offset, blk->data, sizeof(blk->data));
  }
  flash_area_close(flash_area);

  if (ret != 0) {
    prv_coredump_writer_assert_and_reboot(ret);
  }

  return true;
}
bool memfault_platform_coredump_storage_read(uint32_t offset, void *data, size_t read_len) {
  if (!prv_op_within_flash_bounds(offset, read_len)) {
    return false;
  }

  // The internal flash is memory mapped so we can just use memcpy!
  const uint32_t start_addr = FLASH_STORAGE_MEMMAPPED_ADDRESS;
  memcpy(data, (void *)(start_addr + offset), read_len);
  return true;
}

bool memfault_platform_coredump_storage_erase(uint32_t offset, size_t erase_size) {
  if (!prv_op_within_flash_bounds(offset, erase_size)) {
    return false;
  }

  if (((offset % FLASH_ERASE_SIZE) != 0) || (erase_size % FLASH_ERASE_SIZE) != 0) {
    // configuration error
    prv_coredump_writer_assert_and_reboot(offset);
  }

  // erase block-by-block
  for (size_t sector_offset = 0; sector_offset < erase_size; sector_offset += FLASH_ERASE_SIZE) {
    const struct flash_area *flash_area;
    int ret = flash_area_open(FLASH_PARTITION_ID, &flash_area);
    if (ret == 0) {
      ret = flash_area_erase(flash_area, offset + sector_offset, FLASH_ERASE_SIZE);
    }

    flash_area_close(flash_area);

    if (ret != 0) {
      prv_coredump_writer_assert_and_reboot(ret);
    }
  }

  return true;
}
```
